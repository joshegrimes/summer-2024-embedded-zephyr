## CMakeLists.txt
```
# SPDX-License-Identifier: Apache-2.0

cmake_minimum_required(VERSION 3.20.0)

set(BOARD stm32f4_disco)

find_package(Zephyr REQUIRED HINTS $ENV{ZEPHYR_BASE})
project(accel C CXX)

target_sources(app PRIVATE src/main.c)
```

## prj.conf
```kconfig
CONFIG_SPI=y
CONFIG_I2C=n
CONFIG_GPIO=y
CONFIG_SPI_STM32=y
CONFIG_PINCTRL=y

CONFIG_CONSOLE=y
CONFIG_UART_CONSOLE=y
CONFIG_SERIAL=y
CONFIG_STDOUT_CONSOLE=y
CONFIG_CBPRINTF_FP_SUPPORT=y
CONFIG_PRINTK=y

CONFIG_SENSOR=y
CONFIG_LIS2DH=y
CONFIG_LIS2DH_TRIGGER_GLOBAL_THREAD=y
```

## src/main.c
```c
/*
 * STM32F4DISCO Accelerometer Testing
 * Josh Grimes
 * Summer 2024
 */

#include <stdio.h>
#include <zephyr/kernel.h>
#include <zephyr/device.h>
#include <zephyr/drivers/sensor.h>
#include <zephyr/drivers/spi.h>

/*
void fetch_and_display(const struct device *accel)
{
	struct sensor_value acceleration[3];
	int rc = sensor_sample_fetch(accel);
	rc = sensor_channel_get(accel, SENSOR_CHAN_ACCEL_XYZ, acceleration);
	printf("x %f, y %f, z %f", sensor_value_to_double(&acceleration[0]), sensor_value_to_double(&acceleration[1]), sensor_value_to_double(&acceleration[2]));
}
*/

int main(void)
{
	
	const struct device *const accel = DEVICE_DT_GET(DT_ALIAS(lis3dsh));

	if (accel == NULL) 
	{
		printf("No device found\n");
		return 0;
	}
	if (!device_is_ready(accel)) 
	{
		printf("Device %s is NOT ready\n", accel->name);
		return 0;
	}
	else
	{
		printf("Device %s IS ready\n", accel->name);
	}
	
	/*
	while(1)
	{
		fetch_and_display(accel);
	}
	*/

	return 0;
}
```

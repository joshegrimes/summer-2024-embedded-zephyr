## blinky/build/stm32f4_disco/Kconfig/Kconfig.shield.defconfig
```kconfig
osource "c:\Users\joshe\Documents\Summer2024EmbeddedWork\STM32F4DISCO/boards/shields/*/Kconfig.defconfig"
```

## boards/arm/rospi_env/Kconfig.board
```kconfig
# ROSPi Env Board Configuration, based off of:
# "STM32G431RB Nucleo board configuration
# Copyright (c) 2019 Richard Osterloh <richard.osterloh@gmail.com>
# SPDX-License-Identifier: Apache-2.0"

config BOARD_ROSPI_ENV
	bool "ROSPI ENV"
	depends on SOC_STM32G431XX
```

## boards/arm/rospi_env/Kconfig.defconfig
```kconfig
# ROSPi Env Board Configuration, based off of:
# "STM32G431RB Nucleo board configuration
# Copyright (c) 2019 Richard Osterloh <richard.osterloh@gmail.com>
# SPDX-License-Identifier: Apache-2.0"

if BOARD_ROSPI_ENV

config BOARD
	default "rospi_env"

endif # BOARD_ROSPI_ENV

# I was unsure exaclty what to put for "default" under "config BOARD"...
```

## boards/arm/rospi_env/rospi_env_defconfig
```kconfig
# SPDX-License-Identifier: Apache-2.0

CONFIG_SOC_SERIES_STM32G4X=y
CONFIG_SOC_STM32G431XX=y

# enable uart driver
CONFIG_SERIAL=y

# enable GPIO
CONFIG_GPIO=y
CONFIG_GPIO_STM32=y

# enable clocks
CONFIG_CLOCK_CONTROL=y

# Console
CONFIG_CONSOLE=y
CONFIG_UART_CONSOLE=y
CONFIG_CBPRINTF_FP_SUPPORT=y

# Enable MPU
CONFIG_ARM_MPU=y

# Enable HW stack protection
CONFIG_HW_STACK_PROTECTION=y

# enable pin controller
CONFIG_PINCTRL=y

# led strip bus
CONFIG_LED_STRIP=y
CONFIG_WS2812_STRIP=y
CONFIG_WS2812_STRIP_SPI=y

# can
CONFIG_CAN=y
CONFIG_CAN_FD_MODE=y
CONFIG_CAN_STM32_FDCAN=y

# i2c
CONFIG_SENSOR=y
CONFIG_I2C=y
CONFIG_I2C_STM32=y

# spi
CONFIG_SPI=y
CONFIG_SPI_ASYNC=y
CONFIG_SPI_STM32=y

# lps22hb
# CONFIG_LPS22HB=y
```
